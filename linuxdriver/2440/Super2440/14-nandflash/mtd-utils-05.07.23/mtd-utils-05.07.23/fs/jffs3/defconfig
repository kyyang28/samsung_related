## linuxdriver/2440/Super2440/14-nandflash/mtd-utils-05.07.23/mtd-utils-05.07.23/fs/jffs3/defconfig
```kconfig
# JFFS2 Id: defconfig,v 1.1 2003/05/27 09:35:22 dwmw2  Exp
# $Id: defconfig,v 3.3 2005/02/09 14:25:14 pavlov Exp $

CONFIG_JFFS3_FS=m
ifdef NONAND
CONFIG_JFFS3_FS_WRITEBUFFER=n
else
CONFIG_JFFS3_FS_WRITEBUFFER=y
endif
```
